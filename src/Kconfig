## src/Kconfig
```kconfig
# SPDX-License-Identifier: GPL-2.0-only
#
# Realtek device configuration
#

if NET_VENDOR_REALTEK

config R8168
	tristate "Realtek 8168 gigabit ethernet support"
	depends on PCI
	select CRC32
	select PHYLIB
	select REALTEK_PHY
	---help---
	  Say Y here if you have a Realtek 8168 PCI Gigabit Ethernet adapter.

	  To compile this driver as a module, choose M here: the module
	  will be called r8168.  This is recommended.

config R8168_ASPM
	bool "Enable active state power management"
	default y
	---help---
	  Say Y here if you want to enable active state power management for the
	  Realtek R8168 Gigabit ethernet card

	  This is recommended

endif # NET_VENDOR_REALTEK
```
